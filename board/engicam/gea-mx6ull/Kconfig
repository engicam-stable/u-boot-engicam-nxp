## board/engicam/gea-mx6ull/Kconfig
```kconfig
if TARGET_GEA_MX6ULL

config SYS_BOARD
        default "gea-mx6ull"

config SYS_VENDOR
        default "engicam"

config SYS_CONFIG_NAME
        default "gea-mx6ull"

config SYS_TEXT_BASE
        default 0x87800000
endif
```

## board/engicam/imx6ull_isiot/Kconfig
```kconfig
if TARGET_IMX6ULL_ISIOT

config BOOT_FROM_EMMC
	bool "Enable boot from emmc"
	default y
	help
		This option enable boot from emmc and disabled sdcard

config SYS_BOARD
        default "imx6ull_isiot"

config SYS_VENDOR
        default "engicam"

config SYS_CONFIG_NAME
        default "imx6ull-isiot"

config SYS_TEXT_BASE
        default 0x87800000
        
endif
```

## board/engicam/imx8mm_icore/Kconfig
```kconfig
if TARGET_ICORE_MX8MM

config SYS_BOARD
	default "imx8mm_icore"

config SYS_VENDOR
	default "engicam"

config SYS_CONFIG_NAME
	default "imx8mm_icore"

source "board/freescale/common/Kconfig"

endif


if TARGET_ICORE_MX8MM_2GB

config SYS_BOARD
	default "imx8mm_icore"

config SYS_VENDOR
	default "engicam"

config SYS_CONFIG_NAME
	default "imx8mm_icore"

source "board/freescale/common/Kconfig"

endif
```

## board/engicam/imx8x_icore/Kconfig
```kconfig
if TARGET_IMX8X_ICORE

config SYS_BOARD
	default "imx8x_icore"

config SYS_VENDOR
	default "engicam"

config SYS_CONFIG_NAME
	default "imx8x_icore"

source "board/freescale/common/Kconfig"

endif
```

## board/engicam/imx8x_smarcore/Kconfig
```kconfig
if TARGET_IMX8XD_SMARCORE || TARGET_IMX8XQ_SMARCORE

config SYS_BOARD
	default "imx8x_smarcore"

config SYS_VENDOR
	default "engicam"

config SYS_CONFIG_NAME
	default "imx8x_smarcore"

source "board/freescale/common/Kconfig"

endif
```

## configs/imx6ull_isiot_emmc_defconfig
```kconfig
CONFIG_ARM=y
CONFIG_ARCH_MX6=y
CONFIG_TARGET_IMX6ULL_ISIOT=y
CONFIG_ENV_SIZE=0x2000
CONFIG_ENV_OFFSET=0xE0000
CONFIG_DM_GPIO=y
CONFIG_BOOT_FROM_EMMC=y
CONFIG_NR_DRAM_BANKS=1
CONFIG_SMBIOS_PRODUCT_NAME="microgea-mx6ull"
CONFIG_SYS_EXTRA_OPTIONS="IMX_CONFIG=board/engicam/imx6ull_isiot/imximage.cfg"
CONFIG_SD_BOOT=y
CONFIG_BOOTDELAY=3
CONFIG_SUPPORT_RAW_INITRD=y
CONFIG_DEFAULT_FDT_FILE="imx6ull-isiot.dtb"
CONFIG_BOUNCE_BUFFER=y
CONFIG_BOARD_EARLY_INIT_F=y
CONFIG_HUSH_PARSER=y
CONFIG_CMD_BOOTZ=y
CONFIG_CMD_MEMTEST=y
CONFIG_CMD_GPIO=y
CONFIG_CMD_I2C=y
CONFIG_CMD_MMC=y
CONFIG_CMD_MMC_SWRITE=y
CONFIG_CMD_USB=y
CONFIG_CMD_DHCP=y
CONFIG_CMD_PING=y
CONFIG_CMD_CACHE=y
CONFIG_CMD_EXT2=y
CONFIG_CMD_EXT4=y
CONFIG_CMD_EXT4_WRITE=y
CONFIG_CMD_FAT=y
CONFIG_CMD_FS_GENERIC=y
CONFIG_EFI_PARTITION=y
CONFIG_OF_CONTROL=y
CONFIG_DEFAULT_DEVICE_TREE="imx6ull-isiot"
CONFIG_ENV_IS_IN_MMC=y
CONFIG_ENV_VARS_UBOOT_RUNTIME_CONFIG=y
CONFIG_NET_RANDOM_ETHADDR=y
CONFIG_APBH_DMA=y
CONFIG_APBH_DMA_BURST=y
CONFIG_APBH_DMA_BURST8=y
CONFIG_DM_I2C=y
CONFIG_DM_MMC=y
CONFIG_FSL_USDHC=y
CONFIG_MTD=y
CONFIG_MTD_UBI=y
CONFIG_PHYLIB=y
CONFIG_PHY_SMSC=y
CONFIG_FEC_MXC=y
CONFIG_MII=y
CONFIG_PINCTRL=y
CONFIG_PINCTRL_IMX6=y
CONFIG_USB=y
CONFIG_DM_USB=y
CONFIG_USB_STORAGE=y
CONFIG_BCH=y
CONFIG_LZO=y
```
